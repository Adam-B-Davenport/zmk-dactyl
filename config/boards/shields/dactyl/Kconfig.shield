## config/boards/shields/dactyl/Kconfig.shield
```kconfig
config SHIELD_DACTYL_LEFT
    def_bool $(shields_list_contains,dactyl_cc_left)

config SHIELD_DACTYL_RIGHT
    def_bool $(shields_list_contains,dactyl_cc_right)
```
